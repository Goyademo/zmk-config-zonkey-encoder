#include "zonkey.dtsi"

&kscan0 {
    col-gpios
        = <&xiao_d 10 GPIO_ACTIVE_HIGH> // COL 0 (QAZ)
        , <&xiao_d 9  GPIO_ACTIVE_HIGH> // COL 1
        , <&xiao_d 8  GPIO_ACTIVE_HIGH> // COL 2
        , <&xiao_d 7  GPIO_ACTIVE_HIGH> // COL 3
        , <&gpio0 10  GPIO_ACTIVE_HIGH> // COL 4
        , <&gpio0 9   GPIO_ACTIVE_HIGH> // COL 5 (TGB)
        , <&xiao_d 4  GPIO_ACTIVE_HIGH> // COL 6 (★十字キー専用列)
        ;
};
&left_encoder {
    status = "okay";
};

&right_encoder {
    status = "okay";
};
